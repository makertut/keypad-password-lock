//EASY! HOW TO MAKE AN ARDUINO KEYPAD LOCK
// PLASE ADD KEYPAD LIBRARY


#INCLUDE <KEYPAD.H>


CHAR PASSWORD[] = "1234";  // CHANGE THE PASSWORD HERE
INT POSITION = 0;

CONST BYTE ROWS = 4;
CONST BYTE COLS = 4;

CHAR KEYS[ROWS][COLS] = {
{'1','2','3','A'},
{'4','5','6','B'},
{'7','8','9','C'},
{'*','0','#','D'}
};

BYTE ROWPINS[ROWS] = { 2,3,4,5 };
BYTE COLPINS[COLS] = { 6,7,8,9 };
KEYPAD KEYPAD = KEYPAD( MAKEKEYMAP(KEYS), ROWPINS, COLPINS, ROWS, COLS );

INT REDLOCKPIN = 12;
INT GREENUNLOCKPIN = 13;

VOID SETUP()
{
  
    PINMODE(REDLOCKPIN, OUTPUT);
    PINMODE(GREENUNLOCKPIN, OUTPUT);

    LOCKEDPOSITION(TRUE);

}

VOID LOOP()
{
    CHAR KEY = KEYPAD.GETKEY();
   
    IF (KEY == '*' || KEY == '#')
    {
       POSITION = 0;
       LOCKEDPOSITION(TRUE);
    }
    IF (KEY == PASSWORD[POSITION])
    {
       POSITION ++;
    }
    IF (POSITION == 4)
    {
       LOCKEDPOSITION(FALSE);
    }
    
    DELAY(100);
    
}
VOID LOCKEDPOSITION(INT LOCKED)
{
IF (LOCKED)
{
    DIGITALWRITE(REDLOCKPIN, HIGH);
    DIGITALWRITE(GREENUNLOCKPIN, LOW);
}
ELSE
{
    DIGITALWRITE(REDLOCKPIN, LOW);
    DIGITALWRITE(GREENUNLOCKPIN, HIGH);
}
}
